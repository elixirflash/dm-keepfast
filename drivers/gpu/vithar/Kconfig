## drivers/gpu/vithar/Kconfig
```kconfig
menuconfig VITHAR
	tristate "Enable Vithar DDK"
	default n
	help
	  Choose this option to enable 3D rendering with vithar DDK.

config VITHAR_DEBUG
	bool "Vithar debug mode"
	depends on VITHAR
	default n
	help
	  Choose this option to enable Debug mode when it build the DDK.

config VITHAR_HWVER_R0P0
	bool "Vithar HW Version R0P0(EVT1)"
	depends on VITHAR
	default n
	help
	  Choose this option to use EVT1.

config VITHAR_RT_PM
	bool "Enable Runtime power management"
	depends on VITHAR
	default y
	help
	  Choose this option to enable runtime power management on vithar DDK.

config VITHAR_DVFS
	bool "Enable DVFS"
	depends on VITHAR
	default y
	help
	  Choose this option to enable DVFS on vithar DDK.

config VITHAR_DVFS_LIMIT_450
   bool "MAX DVFS clock limit to 450Mhz"
   depends on VITHAR
   default y
   help
     Choose this option to limit DVFS clock to 450Mhz.


config VITHAR_ENABLE_DS5
	bool "Enable DS5"
	depends on VITHAR
	default n
	help
	  Choose this option to enable DS5 on vithar DDK.

config VITHAR_DEBUG_SYS
       bool "Enable sysfs for vithar"
       depends on VITHAR
       default y
       help
         Enables sysfs for vithar device. Set/Monitor Vithar Device
config VITHAR_RTPM_DEBUG
	bool "Enable Runtime Power Management DEBUG"
	depends on VITHAR && VITHAR_RT_PM
	default n
	help
		Choose this option to enable vithar RTPM Debug.
```

## drivers/misc/hsi/Kconfig
```kconfig
#
# sechsi device driver
#

config SAMSUNG_HSI
	bool "MIPI-HSI Support"
	depends on CPU_EXYNOS4212 || CPU_EXYNOS4412 || CPU_EXYNOS5250
	default n
	help
	   When this option is turned on, mipi-hsi support packages will be installed.
```

## drivers/mmc/Kconfig
```kconfig
#
# MMC subsystem configuration
#

menuconfig MMC
	tristate "MMC/SD/SDIO card support"
	depends on HAS_IOMEM
	help
	  This selects MultiMediaCard, Secure Digital and Secure
	  Digital I/O support.

	  If you want MMC/SD/SDIO support, you should say Y here and
	  also to your specific host controller driver.

config MMC_DEBUG
	bool "MMC debugging"
	depends on MMC != n
	help
	  This is an option for use by developers; most people should
	  say N here.  This enables MMC core and driver debugging.

config MMC_4_5_FEATURE_SUPPORT
	bool "MMC 4.5 features config"
	depends on MMC != n
	help
	  If you want MMC discard support, you should say Y here

config MMC_PACKED_COMMANDS
	bool "Enable packed commands"
	depends on MMC_4_5_FEATURE_SUPPORT != n
	help
	  If you want MMC packed commands support, you should say Y here
	  
config MMC_CACHE_CONTROL
	bool "Enable cache control"
	depends on MMC_4_5_FEATURE_SUPPORT != n
	help
	  If you want MMC cache control support, you should say Y here
	  
config MMC_POWEROFF_NOTIFY
	bool "Enable power off notify"
	depends on MMC_4_5_FEATURE_SUPPORT != n
	help
	  If you want MMC power off notify support, you should say Y here  
	  
config MMC_POLLING_WAIT_CMD23
	bool "Wait for cmd23's done interrupt by polling check (EXPERIMENTAL)"
	depends on MMC != n
	help
	  If you say Y here, cmd23 dose not use interrupt.
if MMC

source "drivers/mmc/core/Kconfig"

source "drivers/mmc/card/Kconfig"

source "drivers/mmc/host/Kconfig"

endif # MMC
```
